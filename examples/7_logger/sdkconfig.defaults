## examples/7_logger/sdkconfig.defaults
```kconfig
CONFIG_PARTITION_TABLE_CUSTOM=y
CONFIG_PARTITION_TABLE_CUSTOM_FILENAME="partitions_example.csv"
CONFIG_PARTITION_TABLE_FILENAME="partitions_example.csv"
CONFIG_ESPTOOLPY_FLASHSIZE_4MB=y
# CONFIG_FATFS_LFN_NONE is not set
CONFIG_FATFS_LFN_HEAP=y
# CONFIG_FATFS_LFN_STACK is not set
CONFIG_FATFS_MAX_LFN=255
CONFIG_FATFS_API_ENCODING_ANSI_OEM=y
# CONFIG_FATFS_API_ENCODING_UTF_16 is not set
# CONFIG_FATFS_API_ENCODING_UTF_8 is not set
```

## main/Kconfig.projbuild
```kconfig
menu "Especial Configuration"
    config LED0_GPIO
        int "Indicator LED0 GPIO number"
        range 0 34
        default 22
        help
            GPIO number of Indicator LED0

    config LED1_GPIO
        int "Indicator LED1 GPIO number"
        range 0 34
        default 23
        help
            GPIO number of Indicator LED1

endmenu
```
